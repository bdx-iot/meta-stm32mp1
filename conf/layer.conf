## conf/layer.conf
```bitbake
# We have a conf and classes directory, add to BBPATH
BBPATH .= ":${LAYERDIR}"

# We have recipes-* directories, add to BBFILES
BBFILES += "${LAYERDIR}/recipes-*/*/*.bb \
            ${LAYERDIR}/recipes-*/*/*.bbappend"

BBFILE_COLLECTIONS += "meta-stm32mp1"
BBFILE_PATTERN_meta-stm32mp1 = "^${LAYERDIR}/"
BBFILE_PRIORITY_meta-stm32mp1 = "6"

LAYERDEPENDS_meta-stm32mp1 = "core"
LAYERSERIES_COMPAT_meta-stm32mp1 = "zeus dunfell"

BBFILES_DYNAMIC += " \
    openembedded-layer:${LAYERDIR}/dynamic-layers/openembedded-layer/*/*/*.bb \
    openembedded-layer:${LAYERDIR}/dynamic-layers/openembedded-layer/*/*/*.bbappend \
    \
    qt5-layer:${LAYERDIR}/dynamic-layers/qt5-layer/*/*/*.bb \
    qt5-layer:${LAYERDIR}/dynamic-layers/qt5-layer/*/*/*.bbappend \
"
```

## conf/machine/include/stm32mp1.inc
```bitbake
require conf/machine/include/soc-family.inc

DEFAULTTUNE = "cortexa7thf-neon-vfpv4"

SOC_FAMILY = "stm32mp1"

PREFERRED_PROVIDER_virtual/kernel ??= "linux-mainline"

UBOOT_SUFFIX = "img"
UBOOT_ENTRYPOINT = "0xC2000040"

SERIAL_CONSOLES = "115200;ttySTM0"
SERIAL_CONSOLES_CHECK = "${SERIAL_CONSOLES}"

KERNEL_IMAGETYPE ?= "zImage"

# Do not update fstab file when using wic images
WIC_CREATE_EXTRA_ARGS ?= "--no-fstab-update"

# Image
IMAGE_FSTYPES += "tar.bz2 wic wic.gz wic.bmap ext4 ext4.gz"

WKS_FILE_DEPENDS ?= " \
    virtual/bootloader \
    e2fsprogs-native \
    bmap-tools-native \
"

# Wic default support
WKS_FILE ?= "stm32mp1.wks"

# Define specific EXT4 command line:
#   - Create minimal inode number (as it is done by default in image_types.bbclass)
#   - Deactivate metadata_csum not supported by U-Boot
EXTRA_IMAGECMD_ext4 = "-i 4096 -O ^metadata_csum"
```

## conf/machine/stm32mp157a-dk1.conf
```bitbake
#@TYPE: Machine
#@NAME: stm32mp157a-dk1 machine
#@DESCRIPTION: Reference machine configuration for https://www.st.com/en/evaluation-tools/stm32mp157a-dk1.html
#@MAINTAINER: Pierre-Jean Texier <pjtexier@koncepto.io>
#@MAINTAINER: Joris Offouga <offougajoris@gmail.com>

require conf/machine/include/stm32mp1.inc
include conf/machine/include/tune-cortexa7.inc

# Kernel
KERNEL_DEVICETREE ?= "stm32mp157a-dk1.dtb"

# U-Boot
SPL_BINARY = "u-boot-spl.stm32"
UBOOT_MAKE_TARGET = "DEVICE_TREE=stm32mp157a-dk1 all"
UBOOT_MACHINE = "stm32mp15_basic_defconfig"
UBOOT_EXTLINUX = "1"
UBOOT_EXTLINUX_FDT = "/boot/stm32mp157a-dk1.dtb"
UBOOT_EXTLINUX_ROOT = "root=/dev/mmcblk0p4"
UBOOT_EXTLINUX_CONSOLE = ""

MACHINE_FEATURES = "usbhost usbgadget alsa ext2"

MACHINE_ESSENTIAL_EXTRA_RDEPENDS += " \
    kernel-image \
    kernel-devicetree \
    kernel-modules \
    u-boot \
"
```

## wic/stm32mp1.wks
```
# short-description: Create SD card image for stm32mp1
# long-description: Creates a partitioned SD card image for stm32mp1.

part fsbl1 --source rawcopy --sourceparams="file=u-boot-spl.stm32" --ondisk mmcblk --align 1 --size 256k --part-name fsbl1
part fsbl2 --source rawcopy --sourceparams="file=u-boot-spl.stm32" --ondisk mmcblk --align 1 --size 256k --part-name fsbl2
part ssbl --source rawcopy --sourceparams="file=u-boot.img" --ondisk mmcblk --align 1 --size 2M --part-name ssbl

part / --source rootfs --ondisk mmcblk --fstype=ext4 --mkfs-extraopts="-i 4096 -O ^metadata_csum" --label root --align 1 --size 256M --active

bootloader --ptable gpt
```
